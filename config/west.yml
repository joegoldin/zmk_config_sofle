## config/west.yml
```yaml
manifest:
  remotes:
    - name: zmkfirmware
      url-base: https://github.com/zmkfirmware
    - name: joegoldin
      url-base: https://github.com/joegoldin
  projects:
    - name: zmk
      remote: zmkfirmware
      revision: main
      import: app/west.yml
    - name: nice-view-gem-single-oled
      remote: joegoldin
      revision: main
  self:
    path: config
```
